## config/west.yml
```yaml
manifest:
  remotes:
    - name: zmkfirmware
      url-base: https://github.com/zmkfirmware
    - name: caksoylar
      url-base: https://github.com/caksoylar/zmk
  projects:
    - name: zmk
      remote: caksoylar
      revision: main
      import: app/west.yml
  self:
    path: config
```
